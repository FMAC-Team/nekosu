## Kconfig
```kconfig
menu "NKSU"

config NKSU
	tristate "nksu"
	default y
	help
	  nekosu is a kernel-level rootkit.

config NKSU_DEBUG
	bool "nekosu debug mode"
	depends on NKSU
	default y
	help
	  Enable nekosu debug mode.
	  
config NKSU_SYSCALL
	bool "use syscall hook"
	depends on NKSU
	default n
	help
	  Enable nekosu syscall hook.

endmenu
```

## src/Kconfig
```kconfig
menu "FMAC"

config FMAC
	tristate "File Monitoring and Access"
	default m
	help
	  Enable kernel-level File Monitoring and Access

config FMAC_DEBUG
	bool "FMAC debug mode"
	depends on FMAC
	default y
	help
	  Enable FMAC debug mode.
	  
config FMAC_ROOT
	bool "FMAC ROOT feature"
	depends on FMAC
	default y
	help
	  Enable FMAC root feature.

config FMAC_ROOT_TRACEPOINT
	bool "FMAC ROOT feature by tracepoint"
	depends on TRACING && FMAC_ROOT
	default n
	help
	  Enable FMAC root feature by trace point.

endmenu
```
